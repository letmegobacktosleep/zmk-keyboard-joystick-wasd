## boards/shields/joystick_wasd/Kconfig.defconfig
```kconfig
if SHIELD_JOYSTICK_WASD

# Name must be less than 16 characters long!
config ZMK_KEYBOARD_NAME
    default "Joystick WASD"

endif
```

## boards/shields/joystick_wasd/Kconfig.shield
```kconfig
# No whitespace after the comma or in your keyboard name!
config SHIELD_JOYSTICK_WASD
    def_bool $(shields_list_contains,joystick_wasd)
```

## boards/shields/joystick_wasd_dongle/Kconfig.shield
```kconfig
# No whitespace after the comma or in the keyboard name!
config SHIELD_JOYSTICK_WASD_DONGLE
    def_bool $(shields_list_contains,joystick_wasd_dongle)
```

## config/west.yml
```yaml
manifest:
  defaults:
    revision: v0.3-branch
  remotes:
    - name: zmkfirmware
      url-base: https://github.com/zmkfirmware
    - name: letmegobacktosleep
      url-base: https://github.com/letmegobacktosleep
    # Additional modules containing boards/shields/custom code can be listed here as well
    # See https://docs.zephyrproject.org/3.2.0/develop/west/manifest.html#projects
  projects:
    - name: zmk
      remote: letmegobacktosleep # zmkfirmware
      import: app/west.yml
  self:
    path: config
```

## module/drivers/dts/bindings/kscan/zmk,kscan-joystick.yaml
```yaml
# Copyright (c) 2020, Pete Johanson
# SPDX-License-Identifier: MIT

description: Joystick as a directional switch

compatible: "zmk,kscan-joystick"

include: kscan.yaml

properties:
  io-channels:
    type: phandle-array
    required: true
    description: |
      ADC channels connected to joystick axes.
      First channel is for X-axis, second for Y-axis.
  poll-period-ms:
    type: int
    default: 10
    description: Time between reads in milliseconds when joystick is not in the center.
  idle-period-ms:
    type: int
    default: 100
    description: Time between reads in milliseconds when joystick is in the center.
  angle-offset:
    type: int
    default: 0
    description: The amount of degrees which the angle will be offset by. Must not be negative.
  angle-overlap:
    type: int
    default: 0
    description: The amount of degrees which the directions will overlap.
  n-directions:
    type: int
    default: 4
    description: The number of directions (cols) inferred from the joystick.
  thresholds:
    type: uint8-array
    default: [0x14]
    description: The magnitude thresholds (rows) inferred from the joystick.
  hysteris:
    type: int
    default: 10
    description: The deadzone when a threshold is passed.
```

## module/drivers/kscan/Kconfig
```kconfig
# Copyright (c) 2020 The ZMK Contributors
# SPDX-License-Identifier: MIT

DT_COMPAT_ZMK_KSCAN_JOYSTICK := zmk,kscan-joystick

if KSCAN

config ZMK_KSCAN_JOYSTICK
    bool
    select ADC
    default $(dt_compat_enabled,$(DT_COMPAT_ZMK_KSCAN_JOYSTICK))
    help
      Enable support for the ADC-based key scanning driver.

endif # KSCAN
```
